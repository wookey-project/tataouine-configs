## boards/wookey/proj_wookey/wookey-v2/dfu/mockup_hs_defconfig
```kconfig
#
#
#
#
#
#
#
#
#
#
#
#
#
#
#
#
#
#
#
#
#
#
#
#
#
#
#
#
#
#
#
#
#
#
#
#
#
#
#
#
#
#
#
#
#
#
#
#
#
#
#
#
#
#
#
#
#
#
#
#
#
#
#
#
#
#
#
#
#
#
#
#
#
#
#
#
#
#
#
#
#
#
#
#
#
#
#
#
#
#
#
#
#
#
#
#
#
#
#
#
#
#
#
#
#
#
#
#
#
#
#
#
#
#
#
#
#
#
#
#
#
#
#
#
#
#
#
#
#
#
#
#
#
#
#
#
#
#
#
#
#
#
#
#
#
#
#
#
#
#
#
#
#
#
#
#
#
#
#
#
#
#
#
#
#
#
#
#
#
#
#
#
#
#
#
#
#
#
#
#
#
#
#
#
#
#
#
#
#
#
#
#
#
#
#
#
#
#
#
#
#
#
#
#
#
#
#
#
#
#
#
#
#
#
#
#
#
#
#
#
#
#
#
#
#
#
#
#
# Applications
# Applications IPC and SHM
# AUTH token
# Automatically generated file; DO NOT EDIT.
# Automaton options
# Block device FDE (Full Disk Encryption) options
# Board setup
# Board Support Package
# Bootloader configuration
CONFIG_ADA_ARCH="arm-eabi"
CONFIG_ADAKERNEL=y
CONFIG_ADA_PROFILE="zfp-stm32f4"
CONFIG_AES256_CBC_ESSIV=y
CONFIG_AFLAGS_GCC="-mlittle-endian -mthumb -mcpu=cortex-m4 -mfloat-abi=soft -fPIC -fpie"
CONFIG_AFLAGS_LLVM="--target=thumbv7m-none-eabi -mcpu=cortex-m4 -mfloat-abi=soft -mthumb -fPIC -fpie"
CONFIG_APP_CRYPTO_CFLAGS=""
# CONFIG_APP_CRYPTO_DFU is not set
CONFIG_APP_CRYPTO_DOMAIN=0
CONFIG_APP_CRYPTO_FW=y
CONFIG_APP_CRYPTO_HEAPSIZE=0
CONFIG_APP_CRYPTO_OPTIM_NONE=y
# CONFIG_APP_CRYPTO_OPTIM_O1 is not set
# CONFIG_APP_CRYPTO_OPTIM_O2 is not set
# CONFIG_APP_CRYPTO_OPTIM_O3 is not set
# CONFIG_APP_CRYPTO_OPTIM_OS is not set
# CONFIG_APP_CRYPTO_PERM_DEV_BUSES is not set
CONFIG_APP_CRYPTO_PERM_DEV_CRYPTO=1
CONFIG_APP_CRYPTO_PERM_DEV_DMA=y
# CONFIG_APP_CRYPTO_PERM_DEV_EXTI is not set
# CONFIG_APP_CRYPTO_PERM_DEV_TIM is not set
# CONFIG_APP_CRYPTO_PERM_MEM_DYNAMIC_MAP is not set
CONFIG_APP_CRYPTO_PERM_TIM_GETCYCLES=2
# CONFIG_APP_CRYPTO_PERM_TSK_FIPC is not set
CONFIG_APP_CRYPTO_PERM_TSK_FISR=y
# CONFIG_APP_CRYPTO_PERM_TSK_RESET is not set
CONFIG_APP_CRYPTO_PERM_TSK_RNG=y
# CONFIG_APP_CRYPTO_PERM_TSK_UPGRADE is not set
CONFIG_APP_CRYPTO_PRIO=0
CONFIG_APP_CRYPTO_STACKSIZE=8192
# CONFIG_APP_CRYPTO_USE_GETCYCLES is not set
CONFIG_APP_CRYPTO=y
CONFIG_APP_DFUCRYPTO_DFU=y
# CONFIG_APP_DFUCRYPTO_FW is not set
CONFIG_APP_DFUCRYPTO_HEAPSIZE=0
# CONFIG_APP_DFUCRYPTO_PERM_DEV_BUSES is not set
CONFIG_APP_DFUCRYPTO_PERM_DEV_CRYPTO=1
CONFIG_APP_DFUCRYPTO_PERM_DEV_DMA=y
# CONFIG_APP_DFUCRYPTO_PERM_DEV_EXTI is not set
# CONFIG_APP_DFUCRYPTO_PERM_DEV_TIM is not set
# CONFIG_APP_DFUCRYPTO_PERM_MEM_DYNAMIC_MAP is not set
CONFIG_APP_DFUCRYPTO_PERM_TIM_GETCYCLES=2
# CONFIG_APP_DFUCRYPTO_PERM_TSK_FIPC is not set
CONFIG_APP_DFUCRYPTO_PERM_TSK_FISR=y
# CONFIG_APP_DFUCRYPTO_PERM_TSK_RESET is not set
CONFIG_APP_DFUCRYPTO_PERM_TSK_RNG=y
# CONFIG_APP_DFUCRYPTO_PERM_TSK_UPGRADE is not set
CONFIG_APP_DFUCRYPTO_PRIO=0
CONFIG_APP_DFUCRYPTO_STACKSIZE=8192
CONFIG_APP_DFUCRYPTO=y
CONFIG_APP_DFUFLASH_DFU=y
# CONFIG_APP_DFUFLASH_FW is not set
CONFIG_APP_DFUFLASH_HEAPSIZE=0
CONFIG_APP_DFUFLASH_PERM_DEV_BUSES=y
CONFIG_APP_DFUFLASH_PERM_DEV_CRYPTO=0
CONFIG_APP_DFUFLASH_PERM_DEV_DMA=y
# CONFIG_APP_DFUFLASH_PERM_DEV_EXTI is not set
# CONFIG_APP_DFUFLASH_PERM_DEV_TIM is not set
CONFIG_APP_DFUFLASH_PERM_MEM_DYNAMIC_MAP=y
CONFIG_APP_DFUFLASH_PERM_TIM_GETCYCLES=2
# CONFIG_APP_DFUFLASH_PERM_TSK_FIPC is not set
# CONFIG_APP_DFUFLASH_PERM_TSK_FISR is not set
# CONFIG_APP_DFUFLASH_PERM_TSK_RESET is not set
# CONFIG_APP_DFUFLASH_PERM_TSK_RNG is not set
CONFIG_APP_DFUFLASH_PERM_TSK_UPGRADE=y
CONFIG_APP_DFUFLASH_PRIO=0
CONFIG_APP_DFUFLASH_STACKSIZE=8192
CONFIG_APP_DFUFLASH=y
CONFIG_APP_DFUSMART_DFU=y
# CONFIG_APP_DFUSMART_FW is not set
CONFIG_APP_DFUSMART_HEAPSIZE=0
CONFIG_APP_DFUSMART_PERM_DEV_BUSES=y
CONFIG_APP_DFUSMART_PERM_DEV_CRYPTO=3
CONFIG_APP_DFUSMART_PERM_DEV_DMA=y
CONFIG_APP_DFUSMART_PERM_DEV_EXTI=y
# CONFIG_APP_DFUSMART_PERM_DEV_TIM is not set
CONFIG_APP_DFUSMART_PERM_MEM_DYNAMIC_MAP=y
CONFIG_APP_DFUSMART_PERM_TIM_GETCYCLES=3
# CONFIG_APP_DFUSMART_PERM_TSK_FIPC is not set
CONFIG_APP_DFUSMART_PERM_TSK_FISR=y
CONFIG_APP_DFUSMART_PERM_TSK_RESET=y
CONFIG_APP_DFUSMART_PERM_TSK_RNG=y
CONFIG_APP_DFUSMART_PERM_TSK_UPGRADE=y
CONFIG_APP_DFUSMART_PRIO=2
CONFIG_APP_DFUSMART_STACKSIZE=16384
CONFIG_APP_DFUSMART=y
CONFIG_APP_DFUUSB_DFU=y
# CONFIG_APP_DFUUSB_FW is not set
CONFIG_APP_DFUUSB_HEAPSIZE=1024
CONFIG_APP_DFUUSB_PERM_DEV_BUSES=y
CONFIG_APP_DFUUSB_PERM_DEV_CRYPTO=0
CONFIG_APP_DFUUSB_PERM_DEV_DMA=y
# CONFIG_APP_DFUUSB_PERM_DEV_EXTI is not set
# CONFIG_APP_DFUUSB_PERM_DEV_TIM is not set
CONFIG_APP_DFUUSB_PERM_MEM_DYNAMIC_MAP=y
CONFIG_APP_DFUUSB_PERM_TIM_GETCYCLES=3
# CONFIG_APP_DFUUSB_PERM_TSK_FIPC is not set
CONFIG_APP_DFUUSB_PERM_TSK_FISR=y
# CONFIG_APP_DFUUSB_PERM_TSK_RESET is not set
# CONFIG_APP_DFUUSB_PERM_TSK_RNG is not set
# CONFIG_APP_DFUUSB_PERM_TSK_UPGRADE is not set
CONFIG_APP_DFUUSB_PRIO=1
CONFIG_APP_DFUUSB_STACKSIZE=4096
CONFIG_APP_DFUUSB=y
CONFIG_APPLETS=y
CONFIG_APP_PIN_DFU_INPUT_MOCKUP=y
# CONFIG_APP_PIN_DFU_INPUT_SCREEN is not set
# CONFIG_APP_PIN_DFU_INPUT_USART is not set
CONFIG_APP_PIN_DFU=y
CONFIG_APP_PIN_DOMAIN=0
CONFIG_APP_PIN_FW_INPUT_MOCKUP=y
# CONFIG_APP_PIN_FW_INPUT_SCREEN is not set
# CONFIG_APP_PIN_FW_INPUT_USART is not set
CONFIG_APP_PIN_FW=y
CONFIG_APP_PIN_HEAPSIZE=0
CONFIG_APP_PIN_MAX_PETNAME_LEN=8
CONFIG_APP_PIN_MAX_PETPIN_LEN=4
CONFIG_APP_PIN_MAX_PIN_LEN=4
CONFIG_APP_PIN_MAX_PINTRIES=3
CONFIG_APP_PIN_MOCKUP_DFU_PET_PIN_LEN=4
CONFIG_APP_PIN_MOCKUP_DFU_PET_PIN_VALUE="1234"
CONFIG_APP_PIN_MOCKUP_DFU_USER_PIN_LEN=4
CONFIG_APP_PIN_MOCKUP_DFU_USER_PIN_VALUE="1234"
CONFIG_APP_PIN_MOCKUP_PET_PIN_LEN=4
CONFIG_APP_PIN_MOCKUP_PET_PIN_VALUE="1234"
CONFIG_APP_PIN_MOCKUP_USER_PIN_LEN=4
CONFIG_APP_PIN_MOCKUP_USER_PIN_VALUE="1337"
CONFIG_APP_PIN_PERM_DEV_BUSES=y
CONFIG_APP_PIN_PERM_DEV_CRYPTO=0
CONFIG_APP_PIN_PERM_DEV_DMA=y
CONFIG_APP_PIN_PERM_DEV_EXTI=y
# CONFIG_APP_PIN_PERM_DEV_TIM is not set
# CONFIG_APP_PIN_PERM_MEM_DYNAMIC_MAP is not set
CONFIG_APP_PIN_PERM_TIM_GETCYCLES=1
# CONFIG_APP_PIN_PERM_TSK_FIPC is not set
# CONFIG_APP_PIN_PERM_TSK_FISR is not set
# CONFIG_APP_PIN_PERM_TSK_RESET is not set
CONFIG_APP_PIN_PERM_TSK_RNG=y
# CONFIG_APP_PIN_PERM_TSK_UPGRADE is not set
CONFIG_APP_PIN_PRIO=1
CONFIG_APP_PIN_STACKSIZE=8192
CONFIG_APP_PIN=y
# CONFIG_APP_SDIO_DFU is not set
CONFIG_APP_SDIO_DOMAIN=0
CONFIG_APP_SDIO_FW=y
CONFIG_APP_SDIO_HEAPSIZE=0
CONFIG_APP_SDIO_PERM_DEV_BUSES=y
CONFIG_APP_SDIO_PERM_DEV_CRYPTO=0
CONFIG_APP_SDIO_PERM_DEV_DMA=y
CONFIG_APP_SDIO_PERM_DEV_EXTI=y
CONFIG_APP_SDIO_PERM_DEV_TIM=y
# CONFIG_APP_SDIO_PERM_MEM_DYNAMIC_MAP is not set
CONFIG_APP_SDIO_PERM_TIM_GETCYCLES=3
# CONFIG_APP_SDIO_PERM_TSK_FIPC is not set
CONFIG_APP_SDIO_PERM_TSK_FISR=y
# CONFIG_APP_SDIO_PERM_TSK_RESET is not set
CONFIG_APP_SDIO_PERM_TSK_RNG=y
# CONFIG_APP_SDIO_PERM_TSK_UPGRADE is not set
CONFIG_APP_SDIO_PRIO=0
CONFIG_APP_SDIO_STACKSIZE=6800
CONFIG_APP_SDIO=y
# CONFIG_APP_SMART_DFU is not set
CONFIG_APP_SMART_DOMAIN=0
CONFIG_APP_SMART_FW=y
CONFIG_APP_SMART_HEAPSIZE=0
CONFIG_APP_SMART_PERM_DEV_BUSES=y
CONFIG_APP_SMART_PERM_DEV_CRYPTO=2
CONFIG_APP_SMART_PERM_DEV_DMA=y
CONFIG_APP_SMART_PERM_DEV_EXTI=y
# CONFIG_APP_SMART_PERM_DEV_TIM is not set
CONFIG_APP_SMART_PERM_MEM_DYNAMIC_MAP=y
CONFIG_APP_SMART_PERM_TIM_GETCYCLES=3
# CONFIG_APP_SMART_PERM_TSK_FIPC is not set
CONFIG_APP_SMART_PERM_TSK_FISR=y
CONFIG_APP_SMART_PERM_TSK_RESET=y
CONFIG_APP_SMART_PERM_TSK_RNG=y
# CONFIG_APP_SMART_PERM_TSK_UPGRADE is not set
CONFIG_APP_SMART_PRIO=2
# CONFIG_APP_SMART_SHM is not set
CONFIG_APP_SMART_STACKSIZE=16384
CONFIG_APP_SMART=y
# CONFIG_APP_USB_DFU is not set
CONFIG_APP_USB_DOMAIN=0
CONFIG_APP_USB_FW=y
CONFIG_APP_USB_HEAPSIZE=0
CONFIG_APP_USB_NUMSLOTS=2
CONFIG_APP_USB_PERM_DEV_BUSES=y
CONFIG_APP_USB_PERM_DEV_CRYPTO=0
CONFIG_APP_USB_PERM_DEV_DMA=y
# CONFIG_APP_USB_PERM_DEV_EXTI is not set
# CONFIG_APP_USB_PERM_DEV_TIM is not set
CONFIG_APP_USB_PERM_MEM_DYNAMIC_MAP=y
CONFIG_APP_USB_PERM_TIM_GETCYCLES=3
# CONFIG_APP_USB_PERM_TSK_FIPC is not set
CONFIG_APP_USB_PERM_TSK_FISR=y
# CONFIG_APP_USB_PERM_TSK_RESET is not set
CONFIG_APP_USB_PERM_TSK_RNG=y
# CONFIG_APP_USB_PERM_TSK_UPGRADE is not set
CONFIG_APP_USB_PRIO=0
CONFIG_APP_USB_STACKSIZE=6800
CONFIG_APP_USB=y
CONFIG_ARCH="armv7-m"
CONFIG_ARCH_ARMV7M=y
# CONFIG_ARCH_CORTEX_M3 is not set
CONFIG_ARCH_CORTEX_M4=y
CONFIG_AUTH_TOKEN_MAX_PIN=3
CONFIG_AUTH_TOKEN_MAX_SC=10
CONFIG_AUTH_TOKEN_PET_NAME="Woopy"
CONFIG_AUTH_TOKEN_PET_PIN=1234
CONFIG_AUTH_TOKEN_USER_PIN=1337
CONFIG_BIN_NAME="$(CONFIG_PROJ_NAME).bin"
CONFIG_BOARDNAME="wookey"
CONFIG_BOARD_RELEASE="v2"
CONFIG_BUILD_DIR="build"
CONFIG_CORE_FREQUENCY=168000
CONFIG_CORENAME="cortex-m4"
CONFIG_DBGFLAGS_GCC="-ggdb -Os"
CONFIG_DBGFLAGS_LLVM="-ggdb -Os"
CONFIG_DBGLEVEL=6
CONFIG_DEBUG=y
CONFIG_DFU_TOKEN_MAX_PIN=3
CONFIG_DFU_TOKEN_MAX_SC=10
CONFIG_DFU_TOKEN_PET_NAME="My cat name is Alice!"
CONFIG_DFU_TOKEN_PET_PIN=1234
CONFIG_DFU_TOKEN_USER_PIN=1234
# CONFIG_DISCO407 is not set
# CONFIG_DISCO429 is not set
CONFIG_DMA_SHM=y
CONFIG_DONE=y
CONFIG_DRIVERS_CFLAGS="-Os"
# CONFIG_DRV_OPTIM_NONE is not set
# CONFIG_DRV_OPTIM_PERF1 is not set
# CONFIG_DRV_OPTIM_PERF2 is not set
# CONFIG_DRV_OPTIM_PERF3 is not set
CONFIG_DRV_OPTIM_SIZE=y
# CONFIG_ECC_CURVENAME_BP256 is not set
CONFIG_ECC_CURVENAME_FR256=y
# CONFIG_ECC_CURVENAME_SP256 is not set
CONFIG_ECC_CURVNAME="FRP256V1"
CONFIG_EC_UTILS="tools/ec_utils"
CONFIG_ELF_NAME="$(CONFIG_PROJ_NAME).elf"
CONFIG_EMBEDCFLAGS="-Wl,--gc-sections -ffunction-sections -fno-builtin -ffreestanding -nostdlib -nodefaultlibs"
CONFIG_EXT_ANT_JAVACARD=y
CONFIG_EXTERNALS=y
CONFIG_EXT_GP_PRO=y
CONFIG_EXT_SECAES=y
CONFIG_FIRMWARE_BUILD_MODE_DEBUG=y
# CONFIG_FIRMWARE_BUILD_MODE_PROD is not set
CONFIG_FIRMWARE_DFU=y
CONFIG_FIRMWARE_DUALBANK=y
CONFIG_FIRMWARE_MODE_DUAL_BANK_DFU=y
# CONFIG_FIRMWARE_MODE_DUAL_BANK is not set
# CONFIG_FIRMWARE_MODE_MONO_BANK_DFU is not set
# CONFIG_FIRMWARE_MODE_MONO_BANK is not set
CONFIG_FIRMWARE=y
CONFIG_HEX_NAME="$(CONFIG_PROJ_NAME).hex"
CONFIG_IPC=y
CONFIG_KERN_CFLAGS="-Os"
CONFIG_KERNEL_ADA_BUILDSIZE="size"
CONFIG_KERNEL_CONSOLE_USART1=y
# CONFIG_KERNEL_CONSOLE_USART4 is not set
# CONFIG_KERNEL_CONSOLE_USART6 is not set
CONFIG_KERNEL_DMA_ENABLE=y
# CONFIG_KERNEL_DOMAIN is not set
CONFIG_KERNEL_EWOK=y
CONFIG_KERNEL_EXPERT_MODE=y
# CONFIG_KERNEL_EXP_REENTRANCY is not set
CONFIG_KERNEL_GETCYCLES=y
CONFIG_KERNEL_MODE="debug"
# CONFIG_KERNEL_PANIC_FAULT is not set
CONFIG_KERNEL_PANIC_FREEZE=y
# CONFIG_KERNEL_PANIC_REBOOT is not set
# CONFIG_KERNEL_PANIC_WIPE is not set
# CONFIG_KERNEL_SCHED_DEBUG is not set
CONFIG_KERNEL_SERIAL=y
CONFIG_KERNEL_SOFTIRQ_QUEUE_DEPTH=128
CONFIG_KERNEL_USART=1
# CONFIG_KERN_OPTIM_HYBRID is not set
# CONFIG_KERN_OPTIM_PERF is not set
CONFIG_KERN_OPTIM_SIZE=y
CONFIG_LIB_OPTIM_CFLAGS="-Os"
# CONFIG_LIB_OPTIM_NONE is not set
# CONFIG_LIB_OPTIM_PERF1 is not set
# CONFIG_LIB_OPTIM_PERF2 is not set
# CONFIG_LIB_OPTIM_PERF3 is not set
CONFIG_LIB_OPTIM_SIZE=y
CONFIG_LOADER_CONSOLE_USART1=y
# CONFIG_LOADER_CONSOLE_USART4 is not set
# CONFIG_LOADER_CONSOLE_USART6 is not set
# CONFIG_LOADER_ERASE_ON_SECBREACH is not set
# CONFIG_LOADER_EXTRA_DEBUG is not set
CONFIG_LOADER_FLASH_LOCK=y
# CONFIG_LOADER_FLASH_RDP_CHECK is not set
CONFIG_LOADER_FW_HASH_CHECK=y
CONFIG_LOADER_MOCKUP_DFU=y
CONFIG_LOADER_MOCKUP=y
CONFIG_LOADER_SERIAL=y
CONFIG_LOADER_USART=1
CONFIG_LOADER_USE_BKPSRAM=y
CONFIG_LOADER_USE_PVD=y
CONFIG_MAXTASKS=8
CONFIG_NEED_IPC=y
# CONFIG_OPTIM_NONE is not set
# CONFIG_OPTIM_PERF1 is not set
# CONFIG_OPTIM_PERF2 is not set
# CONFIG_OPTIM_PERF3 is not set
CONFIG_OPTIM_SIZE=y
CONFIG_PRIVATE_DIR="private"
CONFIG_PROJ_FILES="."
CONFIG_PROJ_NAME="wookey"
CONFIG_RAM_SLOT_SIZE=16384
CONFIG_SCHED_MLQ_RR=y
CONFIG_SCHED_PERIOD=10
# CONFIG_SCHED_RAND is not set
# CONFIG_SCHED_RR is not set
# CONFIG_SCHED_SUPPORT_FIPC is not set
CONFIG_SCHED_SUPPORT_FISR=y
CONFIG_SHM=y
CONFIG_SIG_TOKEN_MAX_PIN=3
CONFIG_SIG_TOKEN_MAX_SC=10
CONFIG_SIG_TOKEN_PET_NAME="My fish name is Eve!"
CONFIG_SIG_TOKEN_PET_PIN=1234
CONFIG_SIG_TOKEN_USER_PIN=1234
# CONFIG_SMARTCARD_DEBUG is not set
CONFIG_SOCNAME="stm32f439"
# CONFIG_SPI1 is not set
# CONFIG_SPI2_ENABLE_DMA is not set
CONFIG_SPI2_ROLE_MASTER=y
CONFIG_SPI2=y
# CONFIG_SPI3 is not set
# CONFIG_SPI4 is not set
CONFIG_STACKPROTFLAGS="-fstack-protector-strong"
CONFIG_STACK_PROT_FLAG=y
# CONFIG_STD_DRBG_ENTROPY_CPU_CYCLES is not set
CONFIG_STD_DRBG=y
CONFIG_STD_MALLOC_ALIGN=8
# CONFIG_STD_MALLOC_BINS is not set
CONFIG_STD_MALLOC_LIGHT=y
# CONFIG_STD_MALLOC_MUTEX is not set
CONFIG_STD_MALLOC_SIZE_LEN=16
# CONFIG_STD_MALLOC_STD is not set
CONFIG_STD_MALLOC=y
CONFIG_STD_SANITIZE_HANDLERS=y
CONFIG_STM32F439=y
CONFIG_STM32F4=y
# CONFIG_TDES_CBC_ESSIV is not set
# Configuring Applications
# Configuring communication permissions for appliations
CONFIG_USB_DEV_MANUFACTURER="ANSSI"
CONFIG_USB_DEV_MANUFACTURER_INDEX=2
CONFIG_USB_DEV_PRODNAME_INDEX=1
CONFIG_USB_DEV_PRODNAME="wookey"
CONFIG_USB_DEV_PRODUCTID=0xCAFE
CONFIG_USB_DEV_REVISION="0001"
# CONFIG_USB_DEV_SCSI_BLOCK_SIZE_1024 is not set
# CONFIG_USB_DEV_SCSI_BLOCK_SIZE_2048 is not set
CONFIG_USB_DEV_SCSI_BLOCK_SIZE_4096=y
# CONFIG_USB_DEV_SCSI_BLOCK_SIZE_512 is not set
# CONFIG_USB_DEV_SCSI_BLOCK_SIZE_8192 is not set
CONFIG_USB_DEV_SERIAL="123456789012345678901234"
CONFIG_USB_DEV_SERIAL_INDEX=3
CONFIG_USB_DEV_VENDORID=0xDEAD
CONFIG_USB_DFU=y
# CONFIG_USE_DIFFERENT_PHYSICAL_TOKENS is not set
CONFIG_USE_SIG_TOKEN_BOOL=y
CONFIG_USE_SIG_TOKEN="USE_SIG_TOKEN"
CONFIG_USR_DRV_AD7843_CFLAGS=" -I@PROJFILES@/drivers/boards/wookey/ad7843/api "
CONFIG_USR_DRV_AD7843=y
CONFIG_USR_DRV_CRYP_CFLAGS=" -I@PROJFILES@/drivers/socs/stm32f439/cryp/api "
# CONFIG_USR_DRV_CRYP_DEBUG is not set
CONFIG_USR_DRV_CRYP=y
CONFIG_USR_DRV_DRVISO7816_CFLAGS=" -I@PROJFILES@/drivers/socs/stm32f439/drviso7816/api "
CONFIG_USR_DRV_DRVISO7816=y
# CONFIG_USR_DRV_FLASH_1M is not set
CONFIG_USR_DRV_FLASH_2M=y
CONFIG_USR_DRV_FLASH_CFLAGS=" -I@PROJFILES@/drivers/socs/stm32f439/flash/api "
CONFIG_USR_DRV_FLASH_DUAL_BANK=y
# CONFIG_USR_DRV_FLASH_SINGLE_BANK is not set
CONFIG_USR_DRV_FLASH=y
CONFIG_USR_DRV_HASH_CFLAGS=" -I@PROJFILES@/drivers/socs/stm32f439/hash/api "
CONFIG_USR_DRV_HASH=y
CONFIG_USR_DRV_ILI9341_CFLAGS=" -I@PROJFILES@/drivers/boards/wookey/ili9341/api "
CONFIG_USR_DRV_ILI9341=y
CONFIG_USR_DRV_SDIO_CFLAGS=" -I@PROJFILES@/drivers/socs/stm32f439/sdio/api "
CONFIG_USR_DRV_SDIO=y
CONFIG_USR_DRV_SPI_CFLAGS=" -I@PROJFILES@/drivers/socs/stm32f439/spi/api "
CONFIG_USR_DRV_SPI=y
CONFIG_USR_DRV_USART_CFLAGS=" -I@PROJFILES@/drivers/socs/stm32f439/usart/api "
CONFIG_USR_DRV_USART=y
CONFIG_USR_DRV_USB_CFLAGS=" -I@PROJFILES@/drivers/socs/stm32f439/usb/api "
# CONFIG_USR_DRV_USB_FS is not set
CONFIG_USR_DRV_USB_HS=y
CONFIG_USR_DRV_USB=y
CONFIG_USR_LIB_AES_CFLAGS=" -I@PROJFILES@/libs/aes/api "
CONFIG_USR_LIB_AES_DFU_ALGO_ANSSI_MASKED=y
CONFIG_USR_LIB_AES_DFU_ALGO_CRYP_SUPPORT_DMA=y
# CONFIG_USR_LIB_AES_DFU_ALGO_CRYP_SUPPORT_POLL is not set
CONFIG_USR_LIB_AES_DFU_ALGO_CRYP_SUPPORT=y
# CONFIG_USR_LIB_AES_DFU_ALGO_UNMASKED is not set
# CONFIG_USR_LIB_AES_DFU_PERF is not set
CONFIG_USR_LIB_AES_DIFFERENCIATE_DFU_FW_BUILD=y
CONFIG_USR_LIB_AES_FW_ALGO_ANSSI_MASKED=y
CONFIG_USR_LIB_AES_FW_ALGO_CRYP_SUPPORT_DMA=y
# CONFIG_USR_LIB_AES_FW_ALGO_CRYP_SUPPORT_POLL is not set
CONFIG_USR_LIB_AES_FW_ALGO_CRYP_SUPPORT=y
# CONFIG_USR_LIB_AES_FW_ALGO_UNMASKED_SIMPLE is not set
CONFIG_USR_LIB_AES_FW_ALGO_UNMASKED_TABLE=y
CONFIG_USR_LIB_AES_FW_ALGO_UNMASKED=y
# CONFIG_USR_LIB_AES_FW_PERF is not set
# CONFIG_USR_LIB_AES_SELFTESTS is not set
CONFIG_USR_LIB_AES=y
CONFIG_USR_LIB_AUTOMATON_CFLAGS=" -I@PROJFILES@/libs/automaton/api "
# CONFIG_USR_LIB_AUTOMATON_CONTROL_FLOW_INTEGRITY is not set
# CONFIG_USR_LIB_AUTOMATON_DATA_INTEGRITY_CHECK is not set
CONFIG_USR_LIB_AUTOMATON_DEBUG=0
# CONFIG_USR_LIB_AUTOMATON_HANDLE_CHECKPOINTS is not set
CONFIG_USR_LIB_AUTOMATON_MAX_CONTEXT_NUM=4
CONFIG_USR_LIB_AUTOMATON=y
# CONFIG_USR_LIB_CONSOLE is not set
CONFIG_USR_LIB_DES_CFLAGS=" -I@PROJFILES@/libs/des/api "
CONFIG_USR_LIB_DES=y
CONFIG_USR_LIB_DFU_CAN_DOWNLOAD=y
# CONFIG_USR_LIB_DFU_CAN_UPLOAD is not set
CONFIG_USR_LIB_DFU_CFLAGS=" -I@PROJFILES@/libs/dfu/api "
CONFIG_USR_LIB_DFU=y
CONFIG_USR_LIB_DRBG_USE_HMAC_DRBG=y
CONFIG_USR_LIB_FIRMWARE_BANK_SIZE=0xe0000
CONFIG_USR_LIB_FIRMWARE_CFLAGS=" -I@PROJFILES@/libs/firmware/api "
CONFIG_USR_LIB_FIRMWARE_FLIP_ADDR=0x08020000
CONFIG_USR_LIB_FIRMWARE_FLIP_BOOTINFO_ADDR=0x08008000
CONFIG_USR_LIB_FIRMWARE_FLOP_ADDR=0x08120000
CONFIG_USR_LIB_FIRMWARE_FLOP_BOOTINFO_ADDR=0x08108000
CONFIG_USR_LIB_FIRMWARE=y
# CONFIG_USR_LIB_FIRWARE_SUPPORT_HW_HMAC is not set
CONFIG_USR_LIB_GUI_CFLAGS=" -I@PROJFILES@/libs/gui/api "
CONFIG_USR_LIB_GUI_MAX_MENU_NUMBER=12
CONFIG_USR_LIB_GUI_MAX_TILE_NUMBER=32
CONFIG_USR_LIB_GUI_MODE_FULL=y
# CONFIG_USR_LIB_GUI_MODE_LITE is not set
CONFIG_USR_LIB_GUI=y
CONFIG_USR_LIB_HMAC_CFLAGS=" -I@PROJFILES@/libs/hmac/api "
CONFIG_USR_LIB_HMAC=y
CONFIG_USR_LIB_ISO7816_CFLAGS=" -I@PROJFILES@/libs/iso7816/api "
CONFIG_USR_LIB_ISO7816=y
CONFIG_USR_LIB_MASSSTORAGE_CFLAGS=" -I@PROJFILES@/libs/massstorage/api "
CONFIG_USR_LIB_MASSSTORAGE_DEBUG=0
CONFIG_USR_LIB_MASSSTORAGE=y
CONFIG_USR_LIB_SD_CFLAGS=" -I@PROJFILES@/libs/sd/api "
CONFIG_USR_LIB_SD=y
CONFIG_USR_LIB_SIGN_CFLAGS=" -I../../externals/libecc/src "
CONFIG_USR_LIB_SIGN=y
CONFIG_USR_LIB_SMARTCARD_CFLAGS=" -I@PROJFILES@/libs/smartcard/api "
CONFIG_USR_LIB_SMARTCARD=y
CONFIG_USR_LIB_STD_CFLAGS=" -I@PROJFILES@/libs/std/api "
CONFIG_USR_LIB_STD=y
CONFIG_USR_LIB_TOKEN_CFLAGS=" -I@PROJFILES@/libs/token/api "
CONFIG_USR_LIB_TOKEN=y
CONFIG_USR_LIB_WOOKEY_CFLAGS=" -I@PROJFILES@/libs/wookey/api "
CONFIG_USR_LIB_WOOKEY=y
CONFIG_WARNFLAGS_GCC="-Wl,--gc-sections -Wall -Werror -Wextra -Wno-reserved-id-macro -Wno-padded -Wno-packed -Wno-covered-switch-default -Wno-used-but-marked-unused -Wno-unused-but-set-variable -Wno-unused-function -Werror"
CONFIG_WARNFLAGS_LLVM="-fintegrated-as -sed-command-line-argument -Wno-incompatible-library-redeclaration -Wall -Werror -Wextra -Wno-reserved-id-macro -Wno-padded -Wno-packed -Wno-covered-switch-default -Wno-used-but-marked-unused -Wno-unused-function -Werror"
# CONFIG_WOOKEY_V1 is not set
CONFIG_WOOKEY_V2=y
# CONFIG_WOOKEY_V3 is not set
CONFIG_WOOKEY=y
# CRYPTO     [1]  [1]  [#]    [ ]  [ ]     [ ]      [ ]       [ ]       [ ]
# CRYPTO     [1]  [1]  [#]    [1]  [1]     [ ]       [ ]        [ ]       [ ]
# CRYPTO custom app
# Devices
# Devices
# Devices
# Devices
# Devices
# Devices
# Devices
# Devices
# Devices
# DFUCRYPTO  [ ]  [ ]  [ ]    [ ]  [ ]     [1]      [ ]       [#]       [1]
# DFUCRYPTO  [ ]  [ ]  [ ]    [ ]  [1]     [1]       [1]        [#]       [1]
# DFUCRYPTO custom app
# DFUFLASH   [ ]  [ ]  [ ]    [ ]  [ ]     [ ]       [ ]        [1]       [#]
# DFUFLASH   [ ]  [ ]  [ ]    [ ]  [ ]     [ ]      [1]       [1]       [#]
# DFUFLASH custom app
# DFU-Mode libAES fatures
# DFU-Related Features
# DFUSMART   [ ]  [ ]  [ ]    [ ]  [ ]     [ ]      [#]       [ ]       [ ]
# DFUSMART   [ ]  [ ]  [ ]    [ ]  [1]     [ ]       [#]        [1]       [ ]
# DFUSMART custom app
# DFU token
# DFUUSB     [ ]  [ ]  [ ]    [ ]  [ ]     [#]       [ ]        [1]       [ ]
# DFUUSB     [ ]  [ ]  [ ]    [ ]  [ ]     [#]      [ ]       [1]       [ ]
# DFUUSB custom app
# DRBG configuration
# External tooling and libs
# Firmware options
# Firmware-Related Features
# Firwmare-mode libAES features
# Flash driver options
# General Setup
# Global compile options
# Kernel hacking
# libaes features
# libgui configuration
# libsign features
# Libstd configuration
# libtoken specific options
# Memory management
# Memory management
# Memory management
# Memory management
# Memory management
# Memory management
# Memory management
# Memory management
# Memory management
# Micro-Kernel configuration
# Permissions
# Permissions
# Permissions
# Permissions
# Permissions
# Permissions
# Permissions
# Permissions
# Permissions
# PIN        [ ]  [ ]  [ ]    [ ]  [#]     [ ]      [ ]       [ ]       [ ]
# PIN        [ ]  [ ]  [1]    [1]  [#]     [ ]       [1]        [1]       [ ]
# PIN custom app
# Pin specific properties
# Scheduling schemes
# SCSI options
# SDIO       [#]  [ ]  [1]    [ ]  [ ]     [ ]       [ ]        [ ]       [ ]
# SDIO       [#]  [ ]  [1]    [ ]  [ ]     [ ]      [ ]       [ ]       [ ]
# SDIO custom app
# --------- SDIO  USB CRYPTO SMART PIN   DFUUSB   DFUSMART     DFUCRYPTO DFUFLASH
# --------- SDIO  USB CRYPTO SMART PIN   DFUUSB   DFUSMART  DFUCRYPTO DFUFLASH
# Secure tokens configuration
# SIG token
# SMART      [ ]  [ ]  [ ]    [#]  [ ]     [ ]      [ ]       [ ]       [ ]
# SMART      [ ]  [ ]  [1]    [#]  [1]     [ ]       [ ]        [ ]       [ ]
# SMART custom app
# SoC and Core setup
# SPI block configuration
# Tasking
# Tasking
# Tasking
# Tasking
# Tasking
# Tasking
# Tasking
# Tasking
# Tasking
# Time
# Time
# Time
# Time
# Time
# Time
# Time
# Time
# Time
# USB        [ ]  [#]  [1]    [ ]  [ ]     [ ]       [ ]        [ ]       [ ]
# USB        [ ]  [#]  [1]    [ ]  [ ]     [ ]      [ ]       [ ]       [ ]
# USB custom app
# USB-related features
# Userspace drivers and features
# Userspace drivers library pool
# Userspace utility libraries
# Wookey configuration
```
